## omni_micro_ros_espidf/main/Kconfig.projbuild
```kconfig
menu "Omni micro-ROS application"

config MICRO_ROS_APP_STACK
    int "micro-ROS task stack size"
    default 16000

config MICRO_ROS_APP_TASK_PRIO
    int "micro-ROS task priority"
    default 5

endmenu
```

## omni_micro_ros_espidf/sdkconfig.defaults
```kconfig
CONFIG_IDF_TARGET="esp32s3"
CONFIG_ESPTOOLPY_FLASHSIZE_8MB=y
CONFIG_ESPTOOLPY_FLASHSIZE="8MB"
CONFIG_COMPILER_OPTIMIZATION_SIZE=y
CONFIG_FREERTOS_HZ=1000

CONFIG_MICRO_ROS_ESP_XRCE_DDS_MIDDLEWARE=y
CONFIG_MICRO_ROS_ESP_NETIF_WLAN=y
CONFIG_ESP_WIFI_SSID="SK_ 5G"
CONFIG_ESP_WIFI_PASSWORD="42117622"
CONFIG_ESP_MAXIMUM_RETRY=5
CONFIG_MICRO_ROS_AGENT_IP="192.168.1.128"
CONFIG_MICRO_ROS_AGENT_PORT="8888"
CONFIG_MICRO_ROS_APP_STACK=16000
CONFIG_MICRO_ROS_APP_TASK_PRIO=5
```
